## conf/layer.conf
```bitbake
# We have a conf and classes directory, add to BBPATH
BBPATH .= ":${LAYERDIR}"

# We have recipes-* directories, add to BBFILES
BBFILES += "${LAYERDIR}/recipes-*/*/*.bb \
            ${LAYERDIR}/recipes-*/*/*.bbappend"

BBFILE_COLLECTIONS += "meta-mcp-python-sdk"
BBFILE_PATTERN_meta-mcp-python-sdk = "^${LAYERDIR}/"
BBFILE_PRIORITY_meta-mcp-python-sdk = "6"


LAYERDEPENDS_meta-mcp-python-sdk = "core"
LAYERSERIES_COMPAT_meta-mcp-python-sdk = "scarthgap"
```
